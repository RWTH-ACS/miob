## sw/yocto/meta-miob/conf/layer.conf
```bitbake
# We have a conf and classes directory, add to BBPATH
BBPATH .= ":${LAYERDIR}"

# We have recipes-* directories, add to BBFILES
BBFILES += "${LAYERDIR}/recipes-*/*/*.bb \
            ${LAYERDIR}/recipes-*/*/*.bbappend"

BBFILE_COLLECTIONS += "meta-miob"
BBFILE_PATTERN_meta-miob = "^${LAYERDIR}/"
BBFILE_PRIORITY_meta-miob = "6"

LAYERDEPENDS_meta-miob = "core"
LAYERSERIES_COMPAT_meta-miob = "gatesgarth"
```

## sw/yocto/meta-miob/conf/machine/miob-zcu106-zynqmp.conf
```bitbake
require conf/machine/zcu106-zynqmp.conf

IMAGE_BOOT_FILES_remove = "${KERNEL_IMAGETYPE}-zynqmp-zcu106-rev1.0.dtb"
IMAGE_BOOT_FILES_append = " ${MACHINE}-system.dtb"
```

## sw/yocto/meta-villasnode/conf/layer.conf
```bitbake
# We have a conf and classes directory, add to BBPATH
BBPATH .= ":${LAYERDIR}"

# We have recipes-* directories, add to BBFILES
BBFILES += "${LAYERDIR}/recipes-*/*/*.bb \
            ${LAYERDIR}/recipes-*/*/*.bbappend"

BBFILE_COLLECTIONS += "meta-villasnode"
BBFILE_PATTERN_meta-villasnode = "^${LAYERDIR}/"
BBFILE_PRIORITY_meta-villasnode = "6"

LAYERDEPENDS_meta-villasnode = "core"
LAYERSERIES_COMPAT_meta-villasnode = "gatesgarth"
```
